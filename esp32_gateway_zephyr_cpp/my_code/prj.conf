## CMakeLists.txt
```
# Versión mínima de CMake requerida por Zephyr
cmake_minimum_required(VERSION 3.20.0)

# Export the compile commands for the project
set(CMAKE_EXPORT_COMPILE_COMMANDS ON)


string(REPLACE "/" "_" BOARD_CLEAN ${BOARD})
message(STATUS "--------------------------------------------")
message(STATUS "COMPILING FOR BOARD: ${BOARD_CLEAN}")
message(STATUS "ARCHITECTURE DETECTED:   ${ARCH}")
message(STATUS "--------------------------------------------")

# USE ZEPHYR
find_package(Zephyr REQUIRED HINTS $ENV{ZEPHYR_BASE})

# PROJECT NAME
project(esp32_logs)



# ADD YOUR SOURCE FILE
target_sources(app PRIVATE main.c)
file(GLOB APP_SOURCES "src/*.c")
target_sources(app PRIVATE ${APP_SOURCES})
file(GLOB APP_SOURCES "src/*.cpp")
target_sources(app PRIVATE ${APP_SOURCES})

# Compile all drivers for the board too
message(STATUS "Compiling drivers from folder: drivers/${BOARD_CLEAN}")
file(GLOB BOARD_SOURCES "drivers/${BOARD_CLEAN}/*.c")
target_sources(app PRIVATE ${BOARD_SOURCES})

# Display the list of sources
message(STATUS "List of sources: ${BOARD_SOURCES}")
```

## prj.conf
```kconfig
# Habilitar el motor de Logs
CONFIG_LOG=y

# Usar el formato de log por defecto
CONFIG_LOG_DEFAULT_LEVEL=3

CONFIG_MAIN_STACK_SIZE=4096
CONFIG_SYSTEM_WORKQUEUE_STACK_SIZE=4096


# Habilitar la consola serie (UART)
CONFIG_SERIAL=y
CONFIG_CONSOLE=y
CONFIG_UART_CONSOLE=y



CONFIG_SENSOR=y
CONFIG_GPIO=y
CONFIG_AUXDISPLAY=y

CONFIG_BT=y
CONFIG_BT_PERIPHERAL=y


CONFIG_CPP=y
```

## boards/esp32_devkitc_esp32_procpu.conf
```kconfig
# Configuración básica de memoria para ESP32
CONFIG_AUXDISPLAY_HD44780=y

# Driver específico para el controlador del ESP32
CONFIG_BT_HCI=y
# Reducir la potencia de transmisión (esto ahorra picos de corriente)
#CONFIG_BT_CTLR_TX_PWR_ANTENNA=0

# Opcional: Si tu versión de Zephyr lo soporta, limita el escaneo o eventos de radio
CONFIG_BT_CTLR_TX_PWR_DYNAMIC_CONTROL=y

CONFIG_BT_CTLR_TX_PWR_ANTENNA=-15

# Desactivar funciones que requieren picos de CPU/Radio
CONFIG_BT_ASSERT=n
CONFIG_BT_DEBUG_NONE=y
```

## boards/native_sim.conf
```kconfig
# Desactiva optimizaciones (O0) para que el debugger funcione mejor
# Esto hace que el código sea más lento pero mucho más fácil de depurar
CONFIG_NO_OPTIMIZATIONS=y
```

## boards/esp32_devkitc.overlay
```dts
/* 1. Aseguramos el controlador */
&gpio0 {
status = "okay";
};

/* 2. Definimos la ruta completa para que el compilador no se pierda */
/ {
my_sensors {
/* Aquí simplemente "abrimos" el nodo que ya existe o existirá */
temp_sensor:dht11_sensor {
/* Aquí inyectamos las propiedades específicas de esta placa */
compatible = "pedro,dht11";
dio-gpios = <&gpio0 4 0>;
status = "okay";
};
};
};
```

## boards/esp32_devkitc_esp32_procpu.overlay
```dts
/ {
	my_sensors {
		temp_sensor: dth11_sensor {
			compatible = "pedro,dht11";
			dio-gpios = <&gpio0 27 GPIO_ACTIVE_HIGH>;
			status = "okay";
			sample-text = "Hola desde el Device Tree";
		};
	};

	/* La pantalla LCD con los nombres de variables del YAML */
	lcd0: hd44780 {
		compatible = "hit,hd44780";
		status = "okay";

		/* Según el enum del YAML: 4 para modo 4 bits */
		mode = <4>;

		/* Nombres exactos según el binding */
		register-select-gpios = <&gpio0 26 GPIO_ACTIVE_HIGH>;
		enable-gpios = <&gpio0 25 GPIO_ACTIVE_HIGH>;

		/* El YAML dice: "must contain 8 entries... for 4-bit, the first 4 must be <0>" */
		/* Orden: DB0, DB1, DB2, DB3 (vacíos) -> DB4, DB5, DB6, DB7 (tus pines) */
		data-bus-gpios = <0>,
				 <0>,
				 <0>,
				 <0>,
				 <&gpio0	17 GPIO_ACTIVE_HIGH>,
				 <&gpio0	16 GPIO_ACTIVE_HIGH>,
				 <&gpio0	4 GPIO_ACTIVE_HIGH>,
				 <&gpio0	0 GPIO_ACTIVE_HIGH>;

		/* Estas propiedades vienen de 'auxdisplay-device.yaml' que está incluido */
		columns = <16>;
		rows = <2>;
	};
};
```

## boards/native_sim.overlay
```dts
/ {
	my_sensors {
		temp_sensor: temperature_sensor {
			compatible = "pedro,temperature_sensor";
			status = "okay";
		};
	};

	/* La pantalla LCD con los nombres de variables del YAML */
	lcd0: virtual_lcd {
		compatible = "pedro,virtual_lcd";
		status = "okay";

		file = "/tmp/lcd.txt";
		columns = <16>;
		rows = <2>;
	};
};
```

## dts/bindings/pedro,dht11.yaml
```yaml
description: Driver personalizado para DHT11 de Pedro

compatible: "pedro,dht11"

include: sensor-device.yaml

properties:
  dio-gpios:
    type: phandle-array
    required: true
    description: Pin GPIO conectado al bus de datos del DHT11
  sample-text:
    type: string
    required: true
    description: Texto de prueba
```

## dts/bindings/pedro,temperature_sensor.yaml
```yaml
compatible: "pedro,temperature_sensor"

description: Driver simulado de temperatura (no requiere hardware)

# Heredamos de sensor-device para tener la propiedad 'status' por defecto
include: sensor-device.yaml

# Al ser simulado, dejamos el bloque de properties vacío o solo con lo básico
properties: {}
```

## dts/bindings/pedro,virtual_lcd.yaml
```yaml
description: Driver for virtual lcd in linux tmp file

compatible: "pedro,virtual_lcd"

include: sensor-device.yaml

properties:
  file:
    type: string
    required: true
    description: Path to the file to use as virtual lcd
  columns:
    type: int
    required: true
    description: Number of columns of the virtual lcd
  rows:
    type: int
    required: true
    description: Number of rows of the virtual lcd
```

## src/BLEManager.cpp
```c
#include "BLEManager.h"
#include <errno.h>
#include <stdio.h>
#include <stdlib.h>

// 3. Callback: Esta función se activa cuando el móvil escribe el byte
static ssize_t on_write(struct bt_conn *conn, const struct bt_gatt_attr *attr,
                        const void *buf, uint16_t len, uint16_t offset,
                        uint8_t flags) {

  if (len != 1) {
    return BT_GATT_ERR(BT_ATT_ERR_INVALID_ATTRIBUTE_LEN);
  }

  uint8_t received_value = *((uint8_t *)buf);
  printk("¡Byte recibido por Bluetooth: %d!\n", received_value);

  return len;
}

// 4. Registro del servicio
BT_GATT_SERVICE_DEFINE(
    my_service, BT_GATT_PRIMARY_SERVICE(BT_UUID_MY_SERVICE),
    BT_GATT_CHARACTERISTIC(BT_UUID_MY_CHAR_BYTE,
                           BT_GATT_CHRC_WRITE, // Permite escribir
                           BT_GATT_PERM_WRITE, // Permiso de escritura
                           NULL, on_write, NULL), );

BLEManager::BLEManager() {
  printk("BLEManager::BLEManager()\n");

  int err = bt_enable(NULL);
  if (err) {
    printk("BLEManager::BLEManager() Error al encender la radio: %d\n", err);
    return;
  }

  // 2. Configuramos el anuncio(Advertising)
  // Definimos qué nombre verá el móvil
  uint8_t COMPANY_ID[] = {0x99, 0x99, 0x76, 0x61, 0x6e,
                          0x74, 0x72, 0x6f, 0x6e, 0x00};
  const struct bt_data ad[] = {
      BT_DATA_BYTES(BT_DATA_FLAGS, (BT_LE_AD_GENERAL | BT_LE_AD_NO_BREDR)),
      BT_DATA(BT_DATA_NAME_SHORTENED, "ESP32", 5),
      // BT_DATA(BT_DATA_MANUFACTURER_DATA, COMPANY_ID, 10),
  };

  const struct bt_data sd[] = {
      BT_DATA(BT_DATA_MANUFACTURER_DATA, COMPANY_ID, sizeof(COMPANY_ID)),
      BT_DATA(BT_DATA_NAME_COMPLETE, "ESP32_LCD", 9),
  };

  // 3. ¡A gritar por la antena!
  // BT_LE_EXT_ADV_SCAN
  //
  // BT_LE_ADV_CONN_FAST_2
  err =
      bt_le_adv_start(BT_LE_ADV_NCONN, ad, ARRAY_SIZE(ad), sd, ARRAY_SIZE(sd));
  if (err) {
    printk("Advertising failed to start (err %d)\n", err);
    return;
  }

  printk("Bluetooth iniciado y anunciado correctamente\n");

  received_value = 0;

  bt_addr_le_t addrs[1];
  size_t count = 1;

  bt_id_get(addrs, &count);

  char addr_str[BT_ADDR_LE_STR_LEN];
  bt_addr_le_to_str(&addrs[0], addr_str, sizeof(addr_str));

  printk("Dirección MAC del dispositivo: %s\n", addr_str);
}

BLEManager::~BLEManager() {
  printk("BLEManager::~BLEManager()\n");
  // Apagamos para ahorrar energía o liberar el recurso
  bt_le_adv_stop();
  // Nota: Zephyr no tiene un "bt_disable" completo en todas las versiones,
  // pero detener el anuncio es lo mínimo indispensable.
  printk("Bluetooth detenido\n");
}

void *create_ble_manager() { return new BLEManager(); }
```

## src/BLEManager.h
```c
#ifndef BLE_MANAGER_H
#define BLE_MANAGER_H

#ifdef __cplusplus

#include <zephyr/bluetooth/addr.h>
#include <zephyr/bluetooth/bluetooth.h>
#include <zephyr/bluetooth/gatt.h>
#include <zephyr/bluetooth/uuid.h>

// 1. Definimos el UUID del Servicio y de la Característica
// Este UUID es para el "Cajón" (Servicio)
#define BT_UUID_MY_SERVICE                                                     \
  BT_UUID_DECLARE_128(                                                         \
      BT_UUID_128_ENCODE(0x12345678, 0x1234, 0x5678, 0x1234, 0x56789abcdef0))

// Este UUID es para la "Carpeta" de 1 byte (Característica)
#define BT_UUID_MY_CHAR_BYTE                                                   \
  BT_UUID_DECLARE_128(                                                         \
      BT_UUID_128_ENCODE(0x12345678, 0x1234, 0x5678, 0x1234, 0x56789abcdef1))

class BLEManager {
private:
  uint8_t received_value;

public:
  BLEManager();
  ~BLEManager();
};

extern "C" {
#endif

void *create_ble_manager();

#ifdef __cplusplus
}
#endif

#endif
```
